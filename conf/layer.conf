## conf/layer.conf
```bitbake
# We have a conf and classes directory, add to BBPATH
BBPATH .= ":${LAYERDIR}"

# We have recipes-* directories, add to BBFILES
BBFILES += "${LAYERDIR}/recipes-*/*/*.bb \
            ${LAYERDIR}/recipes-*/*/*.bbappend"

BBFILE_COLLECTIONS += "meta-rpi-touchscreen"
BBFILE_PATTERN_meta-rpi-touchscreen = "^${LAYERDIR}/"
BBFILE_PRIORITY_meta-rpi-touchscreen = "6"

LAYERDEPENDS_meta-rpi-touchscreen = "core"
LAYERSERIES_COMPAT_meta-rpi-touchscreen = "nanbield"
```
